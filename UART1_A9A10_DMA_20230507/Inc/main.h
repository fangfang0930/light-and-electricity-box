/* USER CODE BEGIN Header */
/**
  ******************************************************************************
  * @file           : main.h
  * @brief          : Header for main.c file.
  *                   This file contains the common defines of the application.
  ******************************************************************************
  * @attention
  *
  * <h2><center>&copy; Copyright (c) 2023 STMicroelectronics.
  * All rights reserved.</center></h2>
  *
  * This software component is licensed by ST under BSD 3-Clause license,
  * the "License"; You may not use this file except in compliance with the
  * License. You may obtain a copy of the License at:
  *                        opensource.org/licenses/BSD-3-Clause
  *
  ******************************************************************************
  */
/* USER CODE END Header */

/* Define to prevent recursive inclusion -------------------------------------*/
#ifndef __MAIN_H
#define __MAIN_H

#ifdef __cplusplus
extern "C" {
#endif

/* Includes ------------------------------------------------------------------*/
#include "stm32f4xx_hal.h"
#include "stm32f4xx_hal.h"

/* Private includes ----------------------------------------------------------*/
/* USER CODE BEGIN Includes */

/* USER CODE END Includes */

/* Exported types ------------------------------------------------------------*/
/* USER CODE BEGIN ET */

/* USER CODE END ET */

/* Exported constants --------------------------------------------------------*/
/* USER CODE BEGIN EC */
/* Table of CRC values for high-order byte */
static uint8_t auchCRCHi[] = {
0x00, 0xC1, 0x81, 0x40, 0x01, 0xC0, 0x80, 0x41, 0x01, 0xC0, 0x80, 0x41, 0x00, 0xC1, 0x81,
0x40, 0x01, 0xC0, 0x80, 0x41, 0x00, 0xC1, 0x81, 0x40, 0x00, 0xC1, 0x81, 0x40, 0x01, 0xC0,
0x80, 0x41, 0x01, 0xC0, 0x80, 0x41, 0x00, 0xC1, 0x81, 0x40, 0x00, 0xC1, 0x81, 0x40, 0x01,
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0x00, 0xC1, 0x81, 0x40, 0x01, 0xC0, 0x80, 0x41, 0x01, 0xC0, 0x80, 0x41, 0x00, 0xC1, 0x81,
0x40
} ;
/* Table of CRC values for low-order byte */
static uint8_t auchCRCLo[] = {
0x00, 0xC0, 0xC1, 0x01, 0xC3, 0x03, 0x02, 0xC2, 0xC6, 0x06, 0x07, 0xC7, 0x05, 0xC5, 0xC4,
0x04, 0xCC, 0x0C, 0x0D, 0xCD, 0x0F, 0xCF, 0xCE, 0x0E, 0x0A, 0xCA, 0xCB, 0x0B, 0xC9, 0x09,
0x08, 0xC8, 0xD8, 0x18, 0x19, 0xD9, 0x1B, 0xDB, 0xDA, 0x1A, 0x1E, 0xDE, 0xDF, 0x1F, 0xDD,
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0x44, 0x84, 0x85, 0x45, 0x87, 0x47, 0x46, 0x86, 0x82, 0x42, 0x43, 0x83, 0x41, 0x81, 0x80,
0x40
};
/* USER CODE END EC */

/* Exported macro ------------------------------------------------------------*/
/* USER CODE BEGIN EM */

/* USER CODE END EM */

/* Exported functions prototypes ---------------------------------------------*/
void Error_Handler(void);

/* USER CODE BEGIN EFP */

/* USER CODE END EFP */

/* Private defines -----------------------------------------------------------*/
#define IN6_Pin GPIO_PIN_9
#define IN6_GPIO_Port GPIOI
#define IN3_Pin GPIO_PIN_10
#define IN3_GPIO_Port GPIOI
#define IN4_Pin GPIO_PIN_0
#define IN4_GPIO_Port GPIOF
#define IN1_Pin GPIO_PIN_1
#define IN1_GPIO_Port GPIOF
#define IN2_Pin GPIO_PIN_2
#define IN2_GPIO_Port GPIOF
#define LED1_Pin GPIO_PIN_11
#define LED1_GPIO_Port GPIOF
#define LED2_Pin GPIO_PIN_12
#define LED2_GPIO_Port GPIOF
#define LED4_Pin GPIO_PIN_14
#define LED4_GPIO_Port GPIOF
#define LED3_Pin GPIO_PIN_15
#define LED3_GPIO_Port GPIOF
#define LED6_Pin GPIO_PIN_0
#define LED6_GPIO_Port GPIOG
#define LED5_Pin GPIO_PIN_1
#define LED5_GPIO_Port GPIOG
#define LED11_Pin GPIO_PIN_6
#define LED11_GPIO_Port GPIOH
#define LED7_Pin GPIO_PIN_7
#define LED7_GPIO_Port GPIOH
#define LED13_Pin GPIO_PIN_8
#define LED13_GPIO_Port GPIOH
#define LED12_Pin GPIO_PIN_9
#define LED12_GPIO_Port GPIOH
#define LED15_Pin GPIO_PIN_10
#define LED15_GPIO_Port GPIOH
#define LED14_Pin GPIO_PIN_11
#define LED14_GPIO_Port GPIOH
#define OUT6_Pin GPIO_PIN_13
#define OUT6_GPIO_Port GPIOH
#define OUT5_Pin GPIO_PIN_14
#define OUT5_GPIO_Port GPIOH
#define OUT4_Pin GPIO_PIN_0
#define OUT4_GPIO_Port GPIOI
#define OUT3_Pin GPIO_PIN_1
#define OUT3_GPIO_Port GPIOI
#define OUT2_Pin GPIO_PIN_2
#define OUT2_GPIO_Port GPIOI
#define OUT1_Pin GPIO_PIN_3
#define OUT1_GPIO_Port GPIOI
#define LED_RED_Pin GPIO_PIN_5
#define LED_RED_GPIO_Port GPIOI
#define LED_GREEN_Pin GPIO_PIN_6
#define LED_GREEN_GPIO_Port GPIOI
#define LED_BLUE_Pin GPIO_PIN_7
#define LED_BLUE_GPIO_Port GPIOI
/* USER CODE BEGIN Private defines */


#define ADDR_SELF 0x04         
#define FUNCTION_CODE3  0x03   
#define FUNCTION_CODE10  0x10  

#define ELECTROMAGNETISM_TRIGGER			  0	
#define LIGHT_TRIGGER             			1	
#define LIGHT_ELECTRICITY_TRIGGER			  2		
#define MAX_THYRISTOR_NUM_PRE_ARM                   16     
#define MAX_CHECK_NUM_PRE_ARM_FOR_ANTI_JAMMING      20    
#define FPGA_RAM_BUF                        32
#define ENABLE_TRANSISTOR_BREAKDOWN_PROTECT 0xaa
#define ENABLE_TRANSISTOR_BOD_PROTECT 0xaa
//==LED
#define LED_0    0
#define LED_1    1
#define LED_2    2
#define LED_3    3
#define LED_4    4
#define LED_5    5
#define LED_6    6
#define LED_7    7
#define LED_8    8
#define LED_9    9
#define LED_A    10
#define LED_B    11
#define LED_C    12
#define LED_D    13
#define LED_E    14
#define LED_F    15
#define LED_G    16
#define LED_H    17
#define LED_I    18
#define LED_J    19
#define LED_K    20
#define LED_L    21
#define LED_M    22
#define LED_N    23
#define LED_O    24
#define LED_P    25
#define LED_Q    26
#define LED_R    27
#define LED_S    28
#define LED_T    29
#define LED_U    30
#define LED_V    31
#define LED_W    32
#define LED_X    33
#define LED_Y    34
#define LED_Z    35
#define LED_ZHU    36
#define LED_CONG    37

extern uint8_t sendtxif,sendtxcnt;
extern uint8_t sendtxif1,sendtxcnt1;
extern uint8_t syn_jc,syn_bod,syn_fpga,GYH;
extern uint8_t gyhchecknum,gyfchecknum;;
//extern uint32_t LED_content[36][8];
//extern uint32_t LED_scan[8];
/* USER CODE END Private defines */

#ifdef __cplusplus
}
#endif

#endif /* __MAIN_H */

/************************ (C) COPYRIGHT STMicroelectronics *****END OF FILE****/
